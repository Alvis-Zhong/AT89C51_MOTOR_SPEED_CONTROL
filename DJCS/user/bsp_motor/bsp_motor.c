/*******************************************************************
	************************************************************
	*
	*@file     bsp_motor.c
	*@author   Bin
	*@data     2017.05
	*@brief    按键控制电机驱动文件
	*
	*************************************************************
*********************************************************************/

#include "bsp_motor.h"

sbit IN2=P2^6;
sbit IN1=P2^5;

uchar number=20; 						
uchar speed_motor=20;
bit flag=1;

/****************************************************************************************
	*@brief		软件延时函数，单位为ms
	*@param		形参ms用于设置延时的长短
	*@retvel	无
*****************************************************************************************/
void delay_ms(uint ms)
{
	uchar i; 
	while(ms--)
	{
		for(i=0;i<120;i++); 
	}
} 

/****************************************************************************************
	*@brief		按键检测函数
	*@param		无
	*@retvel	返回值的按键的状态
*****************************************************************************************/
uchar key_check()
{
	uchar temp=0x00;
	uint i ; 
	if( KEY!=0xff )						//检测按键是否按下
	{
		for(i=0;i<10;i++) ; 		//按键消抖
		if(KEY!=0xff)
		{
			temp = KEY ;					//保存按键状态值
			if( KEY!=0xff )    		//等待按键松开
			{
				for(i=0;i<10;i++); 
			}
		}
	}
	return temp; 							//返回按键状态值
}

/****************************************************************************************
	*@brief		按键状态处理函数
	*@param		temp是按键的状态，根据该状态进行相关的按键控制电机操作
	*@retvel	返回值speed_motor是PWM波的控制变量
*****************************************************************************************/
uchar status_deal(uchar temp)
{
	uchar status;
	status=temp; 
	switch(status)									//对按键检测到的按键值进行判断
	{
		case 0xfe:										//P1.0引脚的按键按下，增加PWM波的占空比
		{
			if(++number>95)						
			{
				number=95 ;
			}
			speed_motor=number;
			break ; 
		}
		case 0xfd:										//P1.1引脚的按键按下,减小PWM波的占空比
		{
			if((--number)<=1)						
			{
				number=1;
			}
			speed_motor=number-1;				
			break ; 
		}
		case 0xfb:										//P1.2引脚的按键按下，改变电机的转动方向
		{
			flag=~flag;
			break;
		}
		case 0xf7:										//P1.3引脚的按键按下，进行电机的停止
		{
			speed_motor=0;
			number=1;
			break;
		}
	}
	return speed_motor ;						//返回控制PWM波的占空比变量
}

/****************************************************************************************
	*@brief		PWM波的控制函数
	*@param		number是改变PWM波占空比的变量值
	*@retvel	无
*****************************************************************************************/
void pwm_control(uchar number)
{
	if(flag)											//根据P1.2按键的状态来控制电机的转动方向
		{
			IN2=0;
			IN1=1;
			delay_ms(number);
			IN1=0;
			delay_ms(95-number);
		}
	else
		{
			IN1=0;
			IN2=1;
			delay_ms(number);
			IN2=0;
			delay_ms(95-number);
		}
}

/****************************************************************************************
	*@brief		综合上述函数，实现按键控制电机的操作函数
	*@param		无
	*@retvel	无
*****************************************************************************************/
void key_con()
{
	pwm_control(status_deal(key_check()));
}



